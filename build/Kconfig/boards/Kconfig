## build/Kconfig/boards/Kconfig
```kconfig
# Load Zephyr board Kconfig descriptions.
osource "/work/zephyr/boards/st/nucleo_f410rb/Kconfig"
```

## build/Kconfig/boards/Kconfig.defconfig
```kconfig
# Load Zephyr board defconfig descriptions.
osource "/work/zephyr/boards/st/nucleo_f410rb/Kconfig.defconfig"
```

## build/Kconfig/boards/Kconfig.nucleo_f410rb
```kconfig
# Load board Kconfig descriptions.
osource "/work/zephyr/boards/st/nucleo_f410rb/Kconfig.nucleo_f410rb"
```

## build/Kconfig/boards/Kconfig.sysbuild
```kconfig
# Load Sysbuild board Kconfig descriptions.
osource "/work/zephyr/boards/st/nucleo_f410rb/Kconfig.sysbuild"
```

## build/Kconfig/soc/Kconfig.sysbuild
```kconfig
# Load Sysbuild SoC Kconfig descriptions.
osource "/work/zephyr/soc/xlnx/zynqmp/Kconfig.sysbuild"
osource "/work/zephyr/soc/xlnx/zynq7000/Kconfig.sysbuild"
osource "/work/zephyr/soc/xlnx/versalnet/Kconfig.sysbuild"
osource "/work/zephyr/soc/xlnx/versal2/Kconfig.sysbuild"
osource "/work/zephyr/soc/xen/Kconfig.sysbuild"
osource "/work/zephyr/soc/wch/ch32v/Kconfig.sysbuild"
osource "/work/zephyr/soc/ti/simplelink/Kconfig.sysbuild"
osource "/work/zephyr/soc/ti/mspm0/Kconfig.sysbuild"
osource "/work/zephyr/soc/ti/lm3s6965/Kconfig.sysbuild"
osource "/work/zephyr/soc/ti/k3/Kconfig.sysbuild"
osource "/work/zephyr/soc/telink/tlsr/Kconfig.sysbuild"
osource "/work/zephyr/soc/starfive/jh71xx/Kconfig.sysbuild"
osource "/work/zephyr/soc/st/stm32/Kconfig.sysbuild"
osource "/work/zephyr/soc/snps/qemu_arc/Kconfig.sysbuild"
osource "/work/zephyr/soc/snps/nsim/arc_v/Kconfig.sysbuild"
osource "/work/zephyr/soc/snps/nsim/arc_classic/Kconfig.sysbuild"
osource "/work/zephyr/soc/snps/hsdk4xd/Kconfig.sysbuild"
osource "/work/zephyr/soc/snps/hsdk/Kconfig.sysbuild"
osource "/work/zephyr/soc/snps/emsk/Kconfig.sysbuild"
osource "/work/zephyr/soc/snps/emsdp/Kconfig.sysbuild"
osource "/work/zephyr/soc/snps/arc_iot/Kconfig.sysbuild"
osource "/work/zephyr/soc/silabs/Kconfig.sysbuild"
osource "/work/zephyr/soc/sifli/sf32/Kconfig.sysbuild"
osource "/work/zephyr/soc/sifive/sifive_freedom/Kconfig.sysbuild"
osource "/work/zephyr/soc/sensry/Kconfig.sysbuild"
osource "/work/zephyr/soc/rockchip/Kconfig.sysbuild"
osource "/work/zephyr/soc/renode/riscv_virtual/Kconfig.sysbuild"
osource "/work/zephyr/soc/renode/cortex_r8_virtual/Kconfig.sysbuild"
osource "/work/zephyr/soc/renesas/smartbond/Kconfig.sysbuild"
osource "/work/zephyr/soc/renesas/rz/Kconfig.sysbuild"
osource "/work/zephyr/soc/renesas/rx/Kconfig.sysbuild"
osource "/work/zephyr/soc/renesas/rcar/Kconfig.sysbuild"
osource "/work/zephyr/soc/renesas/ra/Kconfig.sysbuild"
osource "/work/zephyr/soc/realtek/ec/Kconfig.sysbuild"
osource "/work/zephyr/soc/raspberrypi/rpi_pico/Kconfig.sysbuild"
osource "/work/zephyr/soc/quicklogic/eos_s3/Kconfig.sysbuild"
osource "/work/zephyr/soc/qemu/virt_riscv/Kconfig.sysbuild"
osource "/work/zephyr/soc/qemu/malta/Kconfig.sysbuild"
osource "/work/zephyr/soc/openisa/rv32m1/Kconfig.sysbuild"
osource "/work/zephyr/soc/openhwgroup/cva6/Kconfig.sysbuild"
osource "/work/zephyr/soc/oct/osd32mp15x/Kconfig.sysbuild"
osource "/work/zephyr/soc/nxp/s32/Kconfig.sysbuild"
osource "/work/zephyr/soc/nxp/rw/Kconfig.sysbuild"
osource "/work/zephyr/soc/nxp/mcx/Kconfig.sysbuild"
osource "/work/zephyr/soc/nxp/lpc/Kconfig.sysbuild"
osource "/work/zephyr/soc/nxp/layerscape/Kconfig.sysbuild"
osource "/work/zephyr/soc/nxp/kinetis/Kconfig.sysbuild"
osource "/work/zephyr/soc/nxp/imxrt/Kconfig.sysbuild"
osource "/work/zephyr/soc/nxp/imx/Kconfig.sysbuild"
osource "/work/zephyr/soc/nuvoton/numicro/Kconfig.sysbuild"
osource "/work/zephyr/soc/nuvoton/numaker/Kconfig.sysbuild"
osource "/work/zephyr/soc/nuvoton/npcx/Kconfig.sysbuild"
osource "/work/zephyr/soc/nuvoton/npcm/Kconfig.sysbuild"
osource "/work/zephyr/soc/nordic/Kconfig.sysbuild"
osource "/work/zephyr/soc/neorv32/Kconfig.sysbuild"
osource "/work/zephyr/soc/native/inf_clock/Kconfig.sysbuild"
osource "/work/zephyr/soc/microchip/sam/Kconfig.sysbuild"
osource "/work/zephyr/soc/microchip/sam/sama7/Kconfig.sysbuild"
osource "/work/zephyr/soc/microchip/sam/sam_d5x_e5x/Kconfig.sysbuild"
osource "/work/zephyr/soc/microchip/pic32c/pic32cz_ca/Kconfig.sysbuild"
osource "/work/zephyr/soc/microchip/pic32c/pic32cx_sg/Kconfig.sysbuild"
osource "/work/zephyr/soc/microchip/pic32c/pic32cm_jh/Kconfig.sysbuild"
osource "/work/zephyr/soc/microchip/miv/Kconfig.sysbuild"
osource "/work/zephyr/soc/microchip/mec/Kconfig.sysbuild"
osource "/work/zephyr/soc/mediatek/mt8xxx/Kconfig.sysbuild"
osource "/work/zephyr/soc/lowrisc/opentitan/Kconfig.sysbuild"
osource "/work/zephyr/soc/litex/litex_vexriscv/Kconfig.sysbuild"
osource "/work/zephyr/soc/ite/ec/Kconfig.sysbuild"
osource "/work/zephyr/soc/intel/raptor_lake/Kconfig.sysbuild"
osource "/work/zephyr/soc/intel/panther_lake/Kconfig.sysbuild"
osource "/work/zephyr/soc/intel/lakemont/Kconfig.sysbuild"
osource "/work/zephyr/soc/intel/intel_socfpga_std/Kconfig.sysbuild"
osource "/work/zephyr/soc/intel/intel_socfpga/Kconfig.sysbuild"
osource "/work/zephyr/soc/intel/intel_niosv/Kconfig.sysbuild"
osource "/work/zephyr/soc/intel/intel_ish/Kconfig.sysbuild"
osource "/work/zephyr/soc/intel/intel_adsp/Kconfig.sysbuild"
osource "/work/zephyr/soc/intel/elkhart_lake/Kconfig.sysbuild"
osource "/work/zephyr/soc/intel/atom/Kconfig.sysbuild"
osource "/work/zephyr/soc/intel/apollo_lake/Kconfig.sysbuild"
osource "/work/zephyr/soc/intel/alder_lake/Kconfig.sysbuild"
osource "/work/zephyr/soc/infineon/edge/Kconfig.sysbuild"
osource "/work/zephyr/soc/infineon/cat3/Kconfig.sysbuild"
osource "/work/zephyr/soc/infineon/cat1c/Kconfig.sysbuild"
osource "/work/zephyr/soc/infineon/cat1b/Kconfig.sysbuild"
osource "/work/zephyr/soc/infineon/cat1a/Kconfig.sysbuild"
osource "/work/zephyr/soc/gd/gd32/Kconfig.sysbuild"
osource "/work/zephyr/soc/gaisler/leon3/Kconfig.sysbuild"
osource "/work/zephyr/soc/gaisler/gr716a/Kconfig.sysbuild"
osource "/work/zephyr/soc/espressif/Kconfig.sysbuild"
osource "/work/zephyr/soc/ene/kb1200/Kconfig.sysbuild"
osource "/work/zephyr/soc/ene/kb106x/Kconfig.sysbuild"
osource "/work/zephyr/soc/egis/Kconfig.sysbuild"
osource "/work/zephyr/soc/efinix/sapphire/Kconfig.sysbuild"
osource "/work/zephyr/soc/cdns/xtensa_sample_controller/Kconfig.sysbuild"
osource "/work/zephyr/soc/cdns/sample_controller32/Kconfig.sysbuild"
osource "/work/zephyr/soc/cdns/dc233c/Kconfig.sysbuild"
osource "/work/zephyr/soc/brcm/bcmvk/Kconfig.sysbuild"
osource "/work/zephyr/soc/brcm/bcm2712/Kconfig.sysbuild"
osource "/work/zephyr/soc/brcm/bcm2711/Kconfig.sysbuild"
osource "/work/zephyr/soc/bflb/Kconfig.sysbuild"
osource "/work/zephyr/soc/atmel/sam0/Kconfig.sysbuild"
osource "/work/zephyr/soc/atmel/sam/Kconfig.sysbuild"
osource "/work/zephyr/soc/aspeed/Kconfig.sysbuild"
osource "/work/zephyr/soc/arm/Kconfig.sysbuild"
osource "/work/zephyr/soc/arm/beetle/Kconfig.sysbuild"
osource "/work/zephyr/soc/antmicro/myra/Kconfig.sysbuild"
osource "/work/zephyr/soc/andestech/Kconfig.sysbuild"
osource "/work/zephyr/soc/amd/acp_6_0/Kconfig.sysbuild"
osource "/work/zephyr/soc/ambiq/Kconfig.sysbuild"
osource "/work/zephyr/soc/aesc/Kconfig.sysbuild"
osource "/work/zephyr/soc/adi/max32/Kconfig.sysbuild"
```

## manifest/west.yml
```yaml
manifest:
  projects:
    - name: zephyr
      url: https://github.com/zephyrproject-rtos/zephyr
      revision: v4.3.0
      import: true

    - name: my-lib
      url: https://github.com/lucas-ros/database.git
      revision: master
      path: modules/lib/my-lib   # <- padrão Zephyr
  self:
    path: app
```
